## sdkconfig.defaults
```kconfig
CONFIG_LWIP_IP_FORWARD=y
CONFIG_LWIP_IPV4_NAPT=y
CONFIG_ESP_WIFI_SOFTAP_SUPPORT=y
CONFIG_WPA_ENTERPRISE_SUPPORT=y
CONFIG_WPA_EAP_PEAP=y
CONFIG_WPA_EAP_TLS=y
CONFIG_WPA_EAP_TTLS=y
CONFIG_LWIP_STATS=y
```
